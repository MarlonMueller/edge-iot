## sdkconfig.defaults
```kconfig
CONFIG_IDF_TARGET="esp32s3"

#FreeRTOS on first core
CONFIG_FREERTOS_UNICORE=y

#CONFIG_ESP_DEFAULT_CPU_FREQ_MHZ_80
CONFIG_ESP_DEFAULT_CPU_FREQ_MHZ_160=y
#CONFIG_ESP_DEFAULT_CPU_FREQ_MHZ_240

# O2 compiling
CONFIG_BOOTLOADER_COMPILER_OPTIMIZATION_PERF=y

#
# LoRa Configuration
#
CONFIG_GPIO_RANGE_MAX=48
CONFIG_MISO_GPIO=13
CONFIG_SCK_GPIO=12
CONFIG_MOSI_GPIO=11
CONFIG_CS_GPIO=10
CONFIG_RST_GPIO=2
CONFIG_SPI2_HOST=y

#
# Application Configuration
#
CONFIG_SENDER=y
# CONFIG_RECEIVER is not set
# CONFIG_169MHZ is not set
# CONFIG_433MHZ is not set
# CONFIG_470MHZ is not set
# CONFIG_866MHZ is not set
# CONFIG_915MHZ is not set
CONFIG_OTHER=y
CONFIG_OTHER_FREQUENCY=868
CONFIG_ADVANCED=y
CONFIG_CODING_RATE=1
CONFIG_BANDWIDTH=7
CONFIG_SF_RATE=7
CONFIG_PREAMBLE_LENGTH=8
CONFIG_SYNC_WORD=0x1a
# end of Application Configuration


# Extend app partition size
CONFIG_PARTITION_TABLE_SINGLE_APP_LARGE=y

# SPI RAM
CONFIG_SPIRAM=y
CONFIG_SPIRAM_RODATA=n
CONFIG_SPIRAM_MODE_OCT=y
CONFIG_SPIRAM_SPEED_80M=y
CONFIG_SPIRAM_FETCH_INSTRUCTIONS=n

# Panic behaviour
CONFIG_ESP_SYSTEM_PANIC_PRINT_HALT=y

# Watchdog
CONFIG_ESP_TASK_WDT_EN=n

# Heap tracing
CONFIG_HEAP_TRACING_STANDALONE=n

# Lowest RTC clock source
CONFIG_RTC_CLK_SRC_INT_RC=y

# Skip image validation when exiting deep sleep
CONFIG_BOOTLOADER_SKIP_VALIDATE_IN_DEEP_SLEEP=y

# Timekeeping continues in deep sleep
CONFIG_NEWLIB_TIME_SYSCALL_USE_RTC_HRT=y
```

## src/esp32/Kconfig.projbuild
```kconfig
menu "Custom"

    config HEAP_LOG
        bool "Enable heap logging"
        default n
        help
            Enable heap logging.

    config TIME_LOG
        bool "Enable time logging"
        default n
        help
            Enable time logging.

    config QUANTIZATION_BITS_16
        bool "Use 16-bit quantization"
        default y
        help
            Use 16-bit quantization instead of 8-bit.
   
endmenu
```
